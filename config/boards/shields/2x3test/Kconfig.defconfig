## config/boards/shields/2x3test/Kconfig.defconfig
```kconfig
# Copyright (c) 2022 The ZMK Contributors
# SPDX-License-Identifier: MIT

if SHIELD_2X3TEST

config ZMK_KEYBOARD_NAME
    default "2X3test"

endif
```

## config/boards/shields/2x3test/Kconfig.shield
```kconfig
# Copyright (c) 2022 The ZMK Contributors
# SPDX-License-Identifier: MIT

config SHIELD_2X3TEST
    def_bool $(shields_list_contains,2x3test)
```
